## config/boards/shields/adept_ble/Kconfig.defconfig
```kconfig
# Adept BLE shield 默认值
# SPDX-License-Identifier: MIT
#
# 只在选中本 shield 时生效的默认值。
# 这里只放“必须由 shield 决定”的东西，其余功能开关都写在 adept_ble.conf，
# 方便在一个文件里通读。

if SHIELD_ADEPT_BLE

# 蓝牙设备名（电脑 / 手机搜索时显示的名字）
config ZMK_KEYBOARD_NAME
	default "Adept BLE"

endif
```

## config/boards/shields/xm001_adept_ble/Kconfig.shield
```kconfig
# XM001-Adept_BLE shield
# SPDX-License-Identifier: MIT

config SHIELD_XM001_ADEPT_BLE
	def_bool $(shields_list_contains,xm001_adept_ble)
```

## config/west.yml
```yaml
# west 清单：声明本固件依赖哪些外部源码
# SPDX-License-Identifier: MIT
#
# GitHub Actions 构建时会按这份清单拉取源码。改版本号就在这里改。

manifest:
  remotes:
    # ZMK 官方仓库
    - name: zmkfirmware
      url-base: https://github.com/zmkfirmware
    # 轨迹球驱动作者
    - name: badjeff
      url-base: https://github.com/badjeff

  projects:
    # ZMK 本体。revision 用 tag 可以锁定版本、保证每次编译结果一致。
    - name: zmk
      remote: zmkfirmware
      revision: v0.3.0
      import: app/west.yml

    # PMW3610 轨迹球驱动模块。
    # compatible 为 "pixart,pmw3610-alt"，Kconfig 前缀 CONFIG_PMW3610_ALT_*。
    - name: zmk-pmw3610-driver
      remote: badjeff
      revision: main

  self:
    # 本仓库自身（config 目录下放 west.yml，是 ZMK config 仓库的标准布局）
    path: config
```
